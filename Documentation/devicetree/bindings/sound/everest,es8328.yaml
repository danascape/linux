## Documentation/devicetree/bindings/sound/everest,es8328.yaml
```yaml
# SPDX-License-Identifier: (GPL-2.0-only OR BSD-2-Clause)
%YAML 1.2
---
$id: http://devicetree.org/schemas/sound/everest,es8328.yaml#
$schema: http://devicetree.org/meta-schemas/core.yaml#

title: Everest ES8328 audio CODEC

description: |
  Pins on the device (for linking into audio routes):
    * LOUT1
    * LOUT2
    * ROUT1
    * ROUT2
    * LINPUT1
    * RINPUT1
    * LINPUT2
    * RINPUT2
    * Mic Bias

maintainers:
  - Sean Cross <xobs@kosagi.com>

allOf:
  - $ref: dai-common.yaml#

properties:
  compatible:
    enum:
      - everest,es8328
      - everest,es8388

  reg:
    minItems: 1

  clocks:
    minItems: 1
    description: A 22.5792 or 11.2896 MHz clock

  clock-names:
    items:
      - const: mclk
      - const: i2c_clk
      - const: i2s_hclk

  AVDD-supply:
    description: A 3.3V supply that powers up the AVDD pin.

  DVDD-supply:
    description: A 1.8V supply that powers up the DVDD pin.

  PVDD-supply:
    description: A 1.8V to 3.6V supply that powers up the PVDD pin. 

  HPVDD-supply:
    description: A 3.3V supply that powers up the IPVDD pin/

  '#sound-dai-cells':
    const: 1

required:
  - compatible
  - DVDD-supply
  - AVDD-supply
  - PVDD-supply
  - HPVDD-supply
  - clocks
  - reg

unevaluatedProperties: false

examples:
  - |
    i2c {
      #address-cells = <1>;
      #size-cells = <0>;
      es8328: codec@11 {
        compatible = "everest,es8328";
        reg = <0x11>;
        clocks = <&clks 169>;
        DVDD-supply = <&reg_3p3v>;
        AVDD-supply = <&reg_3p3v>;
        PVDD-supply = <&reg_3p3v>;
        HPVDD-supply = <&reg_3p3v>;
      };
    };
```

## Documentation/devicetree/bindings/sound/wlf,wm8904.yaml
```yaml
# SPDX-License-Identifier: (GPL-2.0 OR BSD-2-Clause)
%YAML 1.2
---
$id: http://devicetree.org/schemas/sound/wlf,wm8904.yaml#
$schema: http://devicetree.org/meta-schemas/core.yaml#

title: WM8904 audio CODEC

description: |
  Pins on the device (for linking into audio routes):
      * IN1L
      * IN1R
      * IN2L
      * IN2R
      * IN3L
      * IN3R
      * HPOUTL
      * HPOUTR
      * LINEOUTL
      * LINEOUTR
      * MICBIAS

maintainers:
  - patches@opensource.cirrus.com

allOf:
  - $ref: dai-common.yaml#

properties:
  compatible:
    enum:
      - wlf,wm8904
      - wlf,wm8912

  reg:
    maxItems: 1

  "#sound-dai-cells":
    const: 0

  clocks:
    maxItems: 1

  clock-names:
    const: mclk

required:
  - compatible
  - reg
  - clock-names
  - clocks

unevaluatedProperties: false

examples:
  - |
    i2c {
        #address-cells = <1>;
        #size-cells = <0>;
        codec@1a {
            compatible = "wlf,wm8904";
            reg = <0x1a>;
            clocks = <&pck0>;
            clock-names = "mclk";
        };
    };
```

## drivers/gpu/drm/panel/msm8937-generated/Kconfig
```kconfig
menu "MSM8937 panel drivers generated with linux-mdss-dsi-panel-driver-generator"
	depends on GPIOLIB && OF && REGULATOR
	depends on DRM_MIPI_DSI

config DRM_PANEL_MSM8937_GENERATED
	tristate "Select all generated MSM8937 panel drivers by default"

config DRM_PANEL_XIAOMI_RIVA_HX8394F
	tristate "Xiaomi RIVA HX8394F"
	default DRM_PANEL_MSM8937_GENERATED

config DRM_PANEL_XIAOMI_RIVA_ILI9881C
	tristate "Xiaomi RIVA ILI9881C"
	default DRM_PANEL_MSM8937_GENERATED

config DRM_PANEL_XIAOMI_SANTONI_HX8394F
	tristate "Xiaomi SANTONI HX8394F"
	default DRM_PANEL_MSM8937_GENERATED

config DRM_PANEL_XIAOMI_UGGLITE_OTM1901A
	tristate "Xiaomi UGGLITE OTM1901A"
	default DRM_PANEL_MSM8937_GENERATED

endmenu
```

## drivers/gpu/drm/panel/msm89x7-generated/Kconfig
```kconfig
menu "MSM89x7 panel drivers generated with linux-mdss-dsi-panel-driver-generator"
	depends on GPIOLIB && OF && REGULATOR
	depends on DRM_MIPI_DSI

config DRM_PANEL_MSM89X7_GENERATED
	tristate "Select all generated MSM89X7 panel drivers by default"

config DRM_PANEL_MOTOROLA_CEDRIC_497_TIANMA
	tristate "Motorola CEDRIC 497 TIANMA"
	default DRM_PANEL_MSM89X7_GENERATED

config DRM_PANEL_MOTOROLA_MONTANA_TIANMA
	tristate "Motorola MONTANA TIANMA"
	default DRM_PANEL_MSM89X7_GENERATED

endmenu
```
